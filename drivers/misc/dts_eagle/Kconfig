## drivers/misc/dts_eagle/Kconfig
```kconfig
config DTS_EAGLE
	bool "DTS Eagle driver"
	depends on CONFIG_SND_SOC_QDSP6V2
	select SND_HWDEP
	default n
	help
	 To add DTS Eagle support on QDSP6 targets.
	 Eagle is a DTS pre/post processing
	 package that includes HeadphoneX. The configuration
	 includes sending tuning parameters of various modules.
```
